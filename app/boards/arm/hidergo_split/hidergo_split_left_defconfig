## app/boards/arm/hidergo_split/hidergo_split_left_defconfig
```kconfig
# SPDX-License-Identifier: MIT

CONFIG_SOC_SERIES_NRF52X=y
CONFIG_SOC_NRF52833_QIAA=y
CONFIG_BOARD_HIDERGO_SPLIT_LEFT=y
CONFIG_NEWLIB_LIBC=y
CONFIG_ZMK_HID_CONSUMER_REPORT_USAGES_BASIC=y

# Enable sleep
CONFIG_ZMK_SLEEP=y
CONFIG_ZMK_IDLE_SLEEP_TIMEOUT=1800000
# CONFIG_ZMK_IDLE_SLEEP_TIMEOUT=20000

# EC11
CONFIG_EC11=y
CONFIG_EC11_TRIGGER_GLOBAL_THREAD=y

# Split
CONFIG_ZMK_SPLIT=n
CONFIG_ZMK_SPLIT_ROLE_CENTRAL=n
CONFIG_BT_CTLR_TX_PWR_PLUS_8=y
# Unpair all bluetooth connections
#CONFIG_ZMK_BLE_CLEAR_BONDS_ON_START=y
# Enable MPU
CONFIG_ARM_MPU=y

# enable GPIO
CONFIG_GPIO=y
CONFIG_NRFX_GPIOTE=n

# Enable SPI
CONFIG_SPI=y
CONFIG_SPI_NRFX=y

# Sensors
CONFIG_SENSOR=y

CONFIG_NFCT_PINS_AS_GPIOS=y

# Display drivers without ZMK display
CONFIG_IL0323N=y
CONFIG_ZEPHYR_HDL=y

CONFIG_LOG=y
#CONFIG_ZMK_USB_LOGGING=y
#CONFIG_ZMK_LOG_LEVEL_DBG=y
#CONFIG_LOG_BUFFER_SIZE=10000
#CONFIG_LOG_STRDUP_BUF_COUNT=60
#CONFIG_I2C_LOG_LEVEL_DBG=y
#CONFIG_SPI_LOG_LEVEL_DBG=y
#CONFIG_DISPLAY_LOG_LEVEL_DBG=y
#CONFIG_LVGL_LOG_LEVEL_DBG=y
#CONFIG_LVGL_USE_DEBUG=y
#CONFIG_SENSOR_LOG_LEVEL_DBG=y

#debug display
#CONFIG_LVGL_LOG_LEVEL_DBG=y
# enable i2c
#CONFIG_I2C=y

# IQS5XX
CONFIG_IQS5XX=n
#CONFIG_IQS5XX_THREAD_PRIORITY=100

CONFIG_LED=y
CONFIG_LED_GPIO=y

CONFIG_ZMK_CONFIG=y

CONFIG_USE_DT_CODE_PARTITION=y
CONFIG_BUILD_OUTPUT_UF2=y

CONFIG_MPU_ALLOW_FLASH_WRITE=y
CONFIG_NVS=y
CONFIG_SETTINGS_NVS=y
CONFIG_FLASH=y
CONFIG_FLASH_PAGE_LAYOUT=y
CONFIG_FLASH_MAP=y

# Battery
CONFIG_ZMK_BATTERY_REPORT_INTERVAL=5

CONFIG_BT_PERIPHERAL_PREF_LATENCY=30

# USB
CONFIG_USB_DEVICE_VID=0x1915
CONFIG_USB_DEVICE_PID=0x5210
CONFIG_ZMK_USB=y
CONFIG_ZMK_USB_LOGGING=y
CONFIG_USB_DEVICE_MANUFACTURER="hid:ergo"
CONFIG_USB_DEVICE_PRODUCT="Disconnect MK1(L)"
```

## app/boards/arm/hidergo_split/hidergo_split_right_defconfig
```kconfig
# SPDX-License-Identifier: MIT

CONFIG_SOC_SERIES_NRF52X=y
CONFIG_SOC_NRF52833_QIAA=y
CONFIG_BOARD_HIDERGO_SPLIT_RIGHT=y
CONFIG_NEWLIB_LIBC=y

# Enable sleep
CONFIG_ZMK_SLEEP=y
CONFIG_ZMK_IDLE_SLEEP_TIMEOUT=1800000

# EC11
CONFIG_EC11=y
CONFIG_EC11_TRIGGER_GLOBAL_THREAD=y

# Split
CONFIG_ZMK_SPLIT=y
CONFIG_ZMK_SPLIT_ROLE_CENTRAL=y
CONFIG_BT_CTLR_TX_PWR_PLUS_8=y
# Unpair all bluetooth connections
#CONFIG_ZMK_BLE_CLEAR_BONDS_ON_START=y
# Enable MPU
CONFIG_ARM_MPU=y

# enable GPIO
CONFIG_GPIO=y
CONFIG_NRFX_GPIOTE=n

# Enable SPI
CONFIG_SPI=y
CONFIG_SPI_NRFX=y

# Sensors
CONFIG_SENSOR=y

CONFIG_NFCT_PINS_AS_GPIOS=y

# enable display drivers

#CONFIG_ZMK_DISPLAY=y
#CONFIG_SSD1306=n
#CONFIG_IL0323=y
#CONFIG_LVGL_HOR_RES_MAX=80
#CONFIG_LVGL_VER_RES_MAX=128
#CONFIG_LVGL_BITS_PER_PIXEL=1
#CONFIG_LVGL_COLOR_DEPTH_1=y
#CONFIG_LVGL_DPI=145
#CONFIG_LVGL_VDB_SIZE=100
#CONFIG_LVGL_USE_THEME_MONO=y
#CONFIG_LVGL_THEME_DEFAULT_COLOR_PRIMARY_RED=n
#CONFIG_LVGL_THEME_DEFAULT_COLOR_SECONDARY_RED=n
#CONFIG_LVGL_THEME_DEFAULT_COLOR_PRIMARY_BLACK=y
#CONFIG_LVGL_THEME_DEFAULT_COLOR_SECONDARY_WHITE=y
#CONFIG_ZMK_DISPLAY_STATUS_SCREEN_BUILT_IN=y
#CONFIG_ZMK_WIDGET_BATTERY_STATUS=y
#CONFIG_ZMK_DISPLAY_WORK_QUEUE_DEDICATED=y
#CONFIG_ZMK_DISPLAY_DEDICATED_THREAD_STACK_SIZE=2048
#CONFIG_LVGL_DISPLAY_DEV_NAME="DISPLAY"
#CONFIG_ZMK_DISPLAY_WORK_QUEUE_DEDICATED=y

# Display drivers without ZMK display
CONFIG_IL0323N=y
CONFIG_ZEPHYR_HDL=y


CONFIG_LOG=y
#CONFIG_ZMK_USB_LOGGING=y
#CONFIG_ZMK_LOG_LEVEL_DBG=y
#CONFIG_LOG_BUFFER_SIZE=10000
#CONFIG_LOG_STRDUP_BUF_COUNT=60
#CONFIG_I2C_LOG_LEVEL_DBG=y
#CONFIG_SPI_LOG_LEVEL_DBG=y
#CONFIG_DISPLAY_LOG_LEVEL_DBG=y
#CONFIG_LVGL_LOG_LEVEL_DBG=y
#CONFIG_LVGL_USE_DEBUG=y
#CONFIG_SENSOR_LOG_LEVEL_DBG=y

#debug display
#CONFIG_LVGL_LOG_LEVEL_DBG=y
# enable i2c
CONFIG_I2C=y

# IQS5XX
CONFIG_IQS5XX=y
CONFIG_IQS5XX_THREAD_PRIORITY=100
CONFIG_IQS5XX_INTERRUPT=y
CONFIG_ZMK_MOUSE_PRECISION_TOUCHPAD=y
#CONFIG_IQS5XX_POLL=y


CONFIG_USE_DT_CODE_PARTITION=y
CONFIG_BUILD_OUTPUT_UF2=y

CONFIG_FLASH=y
CONFIG_FLASH_PAGE_LAYOUT=y
CONFIG_NVS=y
CONFIG_MPU_ALLOW_FLASH_WRITE=y
CONFIG_FLASH_MAP=y

# Enable saving configurations to NVS
CONFIG_ZMK_CONFIG=y

# Battery
CONFIG_ZMK_BATTERY_REPORT_INTERVAL=30

CONFIG_BT_PERIPHERAL_PREF_LATENCY=30

# USB
CONFIG_USB_DEVICE_VID=0x1915
CONFIG_USB_DEVICE_PID=0x520f
CONFIG_ZMK_USB=y
CONFIG_ZMK_USB_LOGGING=y
CONFIG_USB_HID_POLL_INTERVAL_MS=1
CONFIG_ENABLE_HID_INT_OUT_EP=y
CONFIG_USB_DEVICE_MANUFACTURER="hid:ergo"
CONFIG_USB_DEVICE_PRODUCT="Disconnect MK1"
```

## app/dts/bindings/behaviors/zmk,behavior-mouse-sensitivity.yaml
```yaml
# Copyright (c) 2020 The ZMK Contributors
# SPDX-License-Identifier: MIT

description: Change mouse sensitivity

compatible: "zmk,behavior-mouse-sensitivity"

include: one_param.yaml

properties:
  delay-ms:
    type: int
```
